/*
 * Copyright (c) 2021 Richard Titmuss
 *
 * SPDX-License-Identifier: MIT
 */

#include "tornblue.dtsi"

&default_transform {
	col-offset = <6>;
};

&kscan0 {
	col-gpios
        = <&gpio0 20 GPIO_ACTIVE_HIGH>
        , <&gpio1 19 GPIO_ACTIVE_HIGH>
        , <&gpio0 18 GPIO_ACTIVE_HIGH>
        , <&gpio0 17 GPIO_ACTIVE_HIGH>
        , <&gpio0 16 GPIO_ACTIVE_HIGH>
        , <&gpio0 15 GPIO_ACTIVE_HIGH>
		;
};
